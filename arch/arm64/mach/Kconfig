## arch/arm64/mach/Kconfig
```kconfig
if ARCH_MMP

menu "Marvell PXA19x8 Implementations"

config MACH_PXA1908DKB
	bool "Marvell's PXA1908 DKB"
	help
	  Say 'Y' here if you want to support the Marvell PXA1908-based
	  DKB Board.

config MACH_J1LTE
	bool "Samsung's PXA1908 J1 LTE Development Board"
	help
	  Say 'Y' here if you want to support the Samsung PXA1908-based
	  J1 LTE Development Board.

config MACH_J1LTE_CHN_CMCC
	bool "Samsung's PXA1908 J1 LTE CHN CMCC Development Board"
	help
	  Say 'Y' here if you want to support the Samsung PXA1908-based
	  J1 LTE CHN CMCC Development Board.

config MACH_XCOVER3LTE
	bool "Samsung's PXA1908 XCOVER3LTE Development Board"
	help
	  Say 'Y' here if you want to support the Samsung PXA1908-based
	  XCOVER3LTE Development Board.
config MACH_J1NLTE
    bool "Samsung's PXA1908 J1NLTE Development Board"
     help
       Say 'Y' here if you want to support the Samsung PXA1908-based
       J1NLTE Development Board.

config MACH_J1NLTE_SEA_OPEN
    bool "Samsung's PXA1908 J1NLTE Development Board"
     help
       Say 'Y' here if you want to support the Samsung PXA1908-based
       J1NLTE SEA OPEN Development Board.
       
config MACH_DEGASVELTE
	bool "Samsung's PXA1908 DEGASVELTE Development Board"
	help
	  Say 'Y' here if you want to support the Samsung PXA1908-based
	  DEGASVELTE Development Board.

config SAMSUNG_PRODUCT_SHIP
    bool "set up for product shipping"
    default n

endmenu

endif
```

## drivers/samsung/Kconfig
```kconfig
menuconfig SEC_DEBUG
        bool "Samsung Ramdump Feature"
        default n
        help
          Samsung Ramdump Feature.

if SEC_DEBUG
config SEC_DEBUG_SCHED_LOG
        bool "Samsung Scheduler Logging Feature"
        default n
	select SEC_DEBUG_TASK_LOG
        help
          Samsung Scheduler Logging Feature for Debug use.

config SEC_DEBUG_TASK_LOG
        bool "Samsung Task Logging Feature"
        default n
        depends on SEC_DEBUG_SCHED_LOG
        help
          Samsung Task Logging Feature for Debug use.

config SEC_DEBUG_IRQ_LOG
        bool "Samsung IRQ Logging Feature"
        default n
        depends on SEC_DEBUG_SCHED_LOG
        help
          Samsung IRQ Logging Feature for Debug use.

config SEC_DEBUG_WORK_LOG
        bool "Samsung Work Logging Feature"
        default n
        depends on SEC_DEBUG_SCHED_LOG
        help
          Samsung Work Logging Feature for Debug use.

config SEC_DEBUG_TIMER_LOG
        bool "Samsung Timer Logging Feature"
        default n
        depends on SEC_DEBUG_SCHED_LOG
        help
          Samsung Timer Logging Feature for Debug use.
endif

config SEC_LOG
        bool "Samsung log buffer"
        default n

config SEC_LOG_LAST_KMSG
        bool "Samsung Use Sec Log Last Kmsg"
        depends on SEC_LOG
        default n
        help
           This feature creats a node to read contents of sec_log_buf
           area just before booting into kernel from bootloader.
           This is very helpful to read sec_log_buf area without reset
           or entering upload mode.

config USER_RESET_DEBUG
	bool "Reset reason debug feature in user version"
	default n
	help
	  This option provides reset history log in user version.
	  This option enable proc/reset_reason support

config MACH_PXA_SAMSUNG
        bool "PXA based Samsung board type"
        depends on ARCH_MMP
        default n
        help
          PXA based samsung board configuration option.

config EXTCON_S2MM001
  bool "S2MM001 microUSB Switch"
  depends on I2C
  help
    If you say yes here you will get support for
    for the S2MM001 MUIC chip.

config EXTCON_SM5504
	bool "SM5504 microUSB Switch"
	depends on I2C
	help
	  The SM5504 is a USB port accessory detector and switch.
	  The SM5504 is fully controlled using I2C and enables USB data,
	  and UART data to use a common connector port.

config EXTCON_SM5502
	bool "SM5502 microUSB Switch"
	depends on I2C
	help
	  The SM5502 is a USB port accessory detector and switch.
	  The SM5502 is fully controlled using I2C and enables USB data,
	  and UART data to use a common connector port.

config SEC_FACTORY
	bool "when it comes to sec factory mode"
	default n
	help
	  It will support a sec factory mode

config ARM64_THREADINFO_SLABCACHE
	bool "makes ARM64 kernel uses thread_info_cache"
	default n
	help
	  ARM64 use alloc_pages_node() basically, because of THREAD_SIZE >= PAGE_SIZE
	  However, let it uses kmem_cache_alloc_node()
	  Sometimes(Low RAM and so much fragmemtation case), it can help memory operation


config THREADINFO_MEMPOOL
	bool "using mempool for creating task"
	default n
	depends on ARM64_THREADINFO_SLABCACHE
	help
	  using mempool for creating task
          
config SEC_BSP
	bool "Samsung TN BSP Feature"
	default n
	depends on SEC_DEBUG
	help
	  Samsung TN BSP Feature.
```

## drivers/sensors/Kconfig
```kconfig
menuconfig NEW_SENSORS
	bool "Sensors Support"
	help
		Say Y to enable Sensors support. This allows control of supported
		Sensors.

if NEW_SENSORS
config SENSORS_CORE
         bool "sensors_core"
         depends on I2C

config SENSORS_K303C
	depends on I2C
	tristate "ST K303C accel,magnetic combo"
	default n
	help
	  This option enables st k303c accel and mag driver

config SENSORS_CM36686
	depends on I2C
	tristate "CM36686 driver"
	default n
	help
	  This option enables proximity & light sensors using CM36686 driver.

config SENSORS_CM36686_LEDA_EN_GPIO
	depends on I2C
	tristate "CM36686 driver"
	default n
	help
	  CM36686 driver use GPIO as leda-en.

config SENSORS_CM36672P
	depends on I2C
	tristate "CM36672P driver"
	default n
	help
	  This option enables proximity sensor using CM36672P driver.

config SENSORS_LEDA_EN_GPIO
	depends on I2C
	tristate "LEDA_EN controlled by GPIO"
	default n
	help
	  This option enables leda_en controlled by GPIO using optical sensor driver.

config SENSORS_K2HH
	depends on I2C
	tristate "ST K2HH accel,magnetic combo"
	default n
	help
	  This option enables st k2hh accel and mag driver

config SENSORS_ACC_EN_GPIO
	depends on I2C
	tristate "ACC_EN controlled by GPIO"
	default n
	help
	  This option enables acc_en controlled by GPIO using accel sensor driver.

config SENSORS_SX9500
	depends on I2C
	tristate "SX9500 driver"
	default n
	help
	  Say Y here if you use sx9500.
	  This option enables grip sensors using
	  SemTech sx9500 device driver.

	  Say N here if you do not use sx9500.

config SENSORS_GRIP_ADJDET
	depends on I2C
	tristate "GRIP sensor adj cable detect"
	default n
	help
	  GRIP sensor adj cable detect

config SENSORS_SX9500_REGULATOR_ONOFF
	tristate "GRIP sensor regulator onoff function"
	default n
	help
	  GRIP sensor regulator onoff

config SENSORS_SX9500_INIT_TOUCH_THRESHOLD
	int "SX9500 Grip sensor threshold for init touch"
	depends on SENSORS_SX9500
	default "3000"
	help
	  This value is the standard of init touch using
	  SemTech sx9500 device driver.

config SENSORS_SX9500_NORMAL_TOUCH_THRESHOLD
	int "SX9500 Grip sensor threshold for normal touch"
	depends on SENSORS_SX9500
	default "17"
	help
	  This value is the standard of normal touch using
	  SemTech sx9500 device driver.
	  
config SENSORS_AK09911C
	tristate "AK09911C compass support"
	default n
	depends on I2C
	help
	  If you say yes here you get support for Asahi Kasei's
	  orientation sensor AK09911C.

config SENSORS_K2HH_SW_I2C
	depends on I2C_GPIO
	tristate "SW I2C for sensor"
	default n
	help
	  This option enable K2HH driver to parse i2c-gpio SDA and SCL pins.

config SENSORS_K2HH_HAS_REGULATOR
	depends on I2C
	tristate "sensor use connected regulator"
	default n
	help
	  This option enable K2HH driver to parse connected regulators.

endif # NEW_SENSORS
```

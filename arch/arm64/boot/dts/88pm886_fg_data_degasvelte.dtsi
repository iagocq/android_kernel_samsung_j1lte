/*
 * Copyright (C) 2014 Marvell
 * Yi Zhang <yizhang@marvell.com>
 */

/* ocv table is for RosaM battery */
/* ntc table is for NCP03XH223E05RL */

&pmic0 {
	charger {
		prechg-current = <450>;
		prechg-voltage = <3000>;
		fastchg-voltage = <4400>;
		fastchg-cur = <1500>;
		fastchg-eoc = <150>;
		fastchg-tout = <8>;
		recharge-thr = <200>;
		dcp-limit = <700>;
		status = "okay";
	};

	battery {
		sleep-period = <1000>;		/* second */
		low-threshold = <30>;		/* % */
		high-threshold = <50>;		/* % */
		alart-percent = <5>;		/* % */

		cc-fixup = <100>;

		power-off-th = <3350>;		/* mv */
		safe-power-off-th = <3000>;	/* mv */

		io-channels = <&gpadc 7>,  /* vbat */
			           <&gpadc 13>, /* vbat_slp */
				   <&gpadc 14>, /* gpadc0_res */
				   <&gpadc 15>, /* gpadc1_res */
				   <&gpadc 16>, /* gpadc2_res */
				   <&gpadc 17>; /* gpadc3_res */
		io-channel-names = "vbat",
				   "vbat_slp",
				   "gpadc0_res",
				   "gpadc1_res",
				   "gpadc2_res",
				   "gpadc3_res";

		bat-capacity = <4000>;	/* mAh */
		ocv-table = <
			3262 3393 3479 3542 3592 3631 3653 3663 3669 3673
			3677 3680 3685 3693 3701 3707 3712 3717 3723 3728
			3732 3736 3739 3743 3746 3750 3754 3757 3761 3764
			3767 3770 3772 3775 3777 3780 3783 3786 3789 3792
			3795 3798 3801 3805 3808 3812 3816 3820 3824 3829
			3833 3838 3843 3848 3854 3860 3867 3874 3881 3890
			3899 3908 3918 3927 3936 3945 3953 3962 3970 3979
			3987 3995 4004 4013 4022 4032 4042 4052 4062 4071
			4080 4090 4100 4111 4121 4132 4142 4153 4164 4175
			4186 4197 4209 4220 4232 4244 4256 4269 4282 4297 4314
		>;

		abs-lowest-temp = <20>;
		t1-degree = <0>;	/* -20C */
		t2-degree = <20>;	/* 0C */
		t3-degree = <50>;	/* 30C */
		t4-degree = <65>;	/* 45C */

		times-in-minus-ten = <2>;
		offset-in-minus-ten = <100>;
		times-in-zero = <1>;
		offset-in-zero = <0>;

		soc-low-th-cycle = <15>;
		soc-high-th-cycle = <85>;

		zero-degree-ohm = <59881>;

		ntc-table =
				/* -25 ~ -21 */
				<192629 25>,
					<183133 24>,
				<174166 23>,
				<165695 22>,
				<157689 21>,

				/* -20 ~ -11 */
				<150121 20>,
				<142980 19>,
				<136118 18>,
				<129748 17>,
				<123714 16>,
				<118029 15>,
				<112591 14>,
				<107437 13>,
				<102549 12>,
				<97913 11>,

				/* -10 ~ -1 */
				<93514 10>,
				<89319 9>,
				<85339 8>,
				<81560 7>,
				<77972 6>,
				<74563 5>,
				<71323 4>,
				<68244 3>,
				<65316 2>,
				<62531 1>, /* negative temperature */

				/* 0 ~ 9 */
				<59881 0>,

				<57367 1>,
				<54973 2>,
				<52692 3>,
				<50518 4>,
				<48446 5>,
				<46471 6>,
				<44586 7>,
				<42789 8>,
				<41074 9>,

				/* 10 ~ 19 */
				<39436 10>,
				<37871 11>,
				<36376 12>,
				<34948 13>,
				<33585 14>,
				<32282 15>,
				<31037 16>,
				<29846 17>,
				<28708 18>,
				<27619 19>,

				/* 20 ~ 29 */
				<26577 20>,
				<25582 21>,
				<24628 22>,
				<23715 23>,
				<22839 24>,
				<22000 25>,
				<21195 26>,
				<20424 27>,
				<19683 28>,
				<18973 29>,

				/* 30 ~ 39 */
				<18292 30>,
				<17640 31>,
				<17014 32>,
				<16414 33>,
				<15838 34>,
				<15285 35>,
				<14755 36>,
				<14245 37>,
				<13756 38>,
				<13286 39>,

				/* 40 ~ 49 */
				<12843 40>,
				<12400 41>,
				<11980 42>,
				<11577 43>,
				<11190 44>,
				<10817 45>,
				<10459 46>,
				<10114 47>,
				<9782 48>,
				<9462 49>,

				/* 50 ~ 59 */
				<9154 50>,
				<8858 51>,
				<8572 52>,
				<8297 53>,
				<8032 54>,
				<7777 55>,
				<7531 56>,
				<7294 57>,
				<7065 58>,
				<6844 59>,

				/* 60 ~ 65 */
				<6631 60>,
				<6429 61>,
				<6429 62>,
				<6046 63>,
				<5865 64>,
				<5690 65>;
	};
};
